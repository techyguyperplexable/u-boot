## configs/r8q_defconfig
```kconfig
CONFIG_ARM=y
CONFIG_ARM64=y
CONFIG_ARCH_SNAPDRAGON=y
CONFIG_ARCH_SM8250=y
CONFIG_DEFAULT_DEVICE_TREE="r8q"
CONFIG_SYS_CONFIG_NAME="r8q"
CONFIG_TEXT_BASE=0x80000000
CONFIG_SYS_LOAD_ADDR=0x80000000
CONFIG_HAVE_TEXT_BASE=y
CONFIG_SKIP_LOWLEVEL_INIT=y
# CONFIG_OF_UPSTREAM is not set
CONFIG_DM=y
CONFIG_DM_GPIO=y
CONFIG_DM_SERIAL=y
CONFIG_DM_RESET=y
CONFIG_POWER_DOMAIN=y
CONFIG_CLK=y
CONFIG_CLK_QCOM_SM8250=y
CONFIG_PINCTRL=y
CONFIG_PINCTRL_QCOM_SM8250=y
CONFIG_MSM_GPIO=y
CONFIG_MSM_GENI_SERIAL=y
CONFIG_DM_PMIC=y
CONFIG_PMIC_QCOM=y
CONFIG_SPMI_MSM=y
CONFIG_CMD_LOG=y
CONFIG_LMB=y
# CONFIG_DISPLAY_CPUINFO is not set
# CONFIG_DISPLAY_BOARDINFO is not set
CONFIG_VIDEO=y
CONFIG_VIDEO_SIMPLEFB=y
CONFIG_VIDEO_DT_SIMPLEFB=y
CONFIG_CFB_CONSOLE=y
```
